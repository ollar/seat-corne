## boards/shields/ollar-kbrd-corne/Kconfig.shield
```kconfig
# Copyright (c) 2020 Pete Johanson
# SPDX-License-Identifier: MIT

config SHIELD_OLLAR_KBRD_CORNE_LEFT
    def_bool $(shields_list_contains,ollar_kbrd_corne_left)

config SHIELD_OLLAR_KBRD_CORNE_RIGHT
    def_bool $(shields_list_contains,ollar_kbrd_corne_right)
```
